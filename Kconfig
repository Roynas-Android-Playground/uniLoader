## Kconfig
```kconfig
#
# For a description of the syntax of this configuration file,
# see Documentation/kbuild/kconfig-language.txt.
#
mainmenu "uniLoader Configuration"

source "arch/Kconfig"

menu "Building options"
	config CROSS_COMPILE
		string "Cross-compiler tool prefix"
		help
		  Same as running 'make CROSS_COMPILE=prefix-' but stored for
		  default make runs in this kernel build directory.  You don't
		  need to set this unless you want the configured kernel build
		  directory to select the cross-compiler automatically.

	config LOGLEVEL
		int "Verbosity of logs"
		default 7

	config COMPRESS_GZIP
		bool "Compress the uniLoader image with gzip"
		default y
		help
		  Select this if you want to use gzip to compress the final uniLoader image.

	config COMPRESS_LZ4
		bool "Compress the uniLoader image with lz4"
		default n
		help
		  Select this if you want to use lz4 to compress the final uniLoader image.
		  This is required on some new MediaTek devices.

	config EMBED_LINUX
		bool "Embed linux kernel and device tree"
		default y
		help
		  Select this if you want uniLoader to load a linux kernel and device tree

	config KERNEL_PATH
		string "Path to kernel image"
		depends on EMBED_LINUX
		default blob/Image
		help
		  Path to the kernel, which is going to get embedded to uniLoader.
		  With kernel decompression enabled this may also be Image.gz,
		  Image.lz4, or Image.xz.

	config KERNEL_DECOMPRESS
		bool "Decompress embedded Linux kernel payloads"
		depends on EMBED_LINUX
		default n
		help
		  Detect compressed kernel images by magic and decompress them into
		  CONFIG_PAYLOAD_ENTRY before entering Linux. Raw Image payloads keep
		  the historical direct-copy behavior.

	if KERNEL_DECOMPRESS

	config KERNEL_DECOMPRESS_GZIP
		bool "gzip kernel payloads"
		default y
		help
		  Support the Linux arm/arm64 Image.gz target.

	config KERNEL_DECOMPRESS_LZ4
		bool "LZ4 kernel payloads"
		default y
		help
		  Support the legacy LZ4 framing emitted by the Linux Image.lz4
		  target (lz4 -l).

	config KERNEL_DECOMPRESS_XZ
		bool "XZ kernel payloads"
		default y
		help
		  Support Linux Image.xz using XZ Embedded in single-call mode,
		  including the ARM and ARM64 BCJ filters used by xz_wrap.sh.

	config KERNEL_DECOMPRESS_MAX_SIZE
		int "Maximum decompressed kernel size in bytes"
		range 1048576 536870912
		default 67108864
		help
		  Maximum amount of memory a compressed payload may write starting
		  at CONFIG_PAYLOAD_ENTRY. Choose a value that fits the board's free
		  handoff memory and doesn't overlap the ramdisk, DT, framebuffer, or
		  other reserved data. This limit doesn't apply to raw Image payloads.

	endif

	config DT_PATH
		string "Path to device tree image"
		depends on EMBED_LINUX
		default blob/dtb
		help
		  Path to the device tree, which is going to get embedded to uniLoader

	config RAMDISK_PATH
		string "Path to ramdisk image"
		depends on EMBED_LINUX
		default blob/ramdisk
		help
		  Path to the ramdisk, which is going to get embedded to uniLoader
	
	config RAMDISK_NO_COPY
		bool "Do not copy ramdisk"
		depends on EMBED_LINUX
		default n
		help
		  Select this if the bootloader copies the ramdisk itself

endmenu

source "drivers/Kconfig"

source "lib/Kconfig"

source "soc/Kconfig"

source "board/Kconfig"
```
